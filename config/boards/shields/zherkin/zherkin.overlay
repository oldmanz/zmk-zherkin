/*
 * Copyright (c) 2020 The ZMK Contributors
 *
 * SPDX-License-Identifier: MIT
 */

#include <dt-bindings/zmk/matrix_transform.h>

/ {

	chosen {
		zmk,kscan = &kscan0;
	};
	kscan0: kscan {
		compatible = "zmk,kscan-gpio-matrix";
		label = "KSCAN";
		diode-direction = "col2row";
		col-gpios
	            = <&pro_micro_a 6   GPIO_ACTIVE_HIGH>
	            , <&pro_micro_d 7   GPIO_ACTIVE_HIGH>
	            , <&pro_micro_a 8   GPIO_ACTIVE_HIGH>
	            , <&pro_micro_d 16  GPIO_ACTIVE_HIGH>
	            , <&pro_micro_d 14  GPIO_ACTIVE_HIGH>
	            , <&pro_micro_d 15  GPIO_ACTIVE_HIGH>
	            , <&pro_micro_d 18  GPIO_ACTIVE_HIGH>
	            , <&pro_micro_d 19  GPIO_ACTIVE_HIGH>
	            , <&pro_micro_d 20  GPIO_ACTIVE_HIGH>
	            , <&pro_micro_d 21  GPIO_ACTIVE_HIGH>
	            ;

	        row-gpios
	            = <&pro_micro_a 2 (GPIO_ACTIVE_HIGH | GPIO_PULL_DOWN)>
	            , <&pro_micro_d 3 (GPIO_ACTIVE_HIGH | GPIO_PULL_DOWN)>
	            , <&pro_micro_d 4 (GPIO_ACTIVE_HIGH | GPIO_PULL_DOWN)>
	            , <&pro_micro_d 5 (GPIO_ACTIVE_HIGH | GPIO_PULL_DOWN)>
	            ;
	};

};
