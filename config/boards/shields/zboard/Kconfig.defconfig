## config/boards/shields/zboard/Kconfig.defconfig
```kconfig
# Copyright (c) 2020 The ZMK Contributors
# SPDX-License-Identifier: MIT

if SHIELD_ZBOARD_LEFT

config ZMK_KEYBOARD_NAME
	default "Zboard"

config ZMK_SPLIT_BLE_ROLE_CENTRAL
	default y

endif

if SHIELD_ZBOARD_LEFT || SHIELD_ZBOARD_RIGHT

config ZMK_SPLIT
	default y

endif
```

## config/boards/shields/zboard/Kconfig.shield
```kconfig
# Copyright (c) 2020 The ZMK Contributors
# SPDX-License-Identifier: MIT

config SHIELD_ZBOARD_LEFT
	def_bool $(shields_list_contains,zboard_left)

config SHIELD_ZBOARD_RIGHT
	def_bool $(shields_list_contains,zboard_right)
```

## config/boards/shields/zherkin/Kconfig.defconfig
```kconfig
# Copyright (c) 2020 The ZMK Contributors
# SPDX-License-Identifier: MIT

if SHIELD_ZHERKIN

config ZMK_KEYBOARD_NAME
    default "Zherkin"

endif
```
